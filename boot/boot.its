## boot/boot.its
```
/dts-v1/;

/ {
	description = "U-boot FIT Image for VisionFive 2";
	#address-cells = <2>;

	images {
		kernel {
			description = "Bootloader Image";
			data = /incbin/("build/bootloader.img");
			type = "kernel";
			arch = "riscv";
			os = "linux";
			load = <0x0 0x40200000>;
			entry = <0x0 0x40200000>;
			compression = "none";
		};

		fdt {
			description = "Flat Device Tree";
			data = /incbin/("../res/jh7110-starfive-visionfive-2-v1.3b.dtb");
			type = "flat_dt";
			arch = "riscv";
			load = <0x0 0x46000000>;
			compression = "none";
		};

		ramdisk {
			description = "Initial Ramdisk";
			data = /incbin/("../res/initramfs.cpio");
			type = "ramdisk";
			arch = "riscv";
			os = "linux";
			load = <0x0 0x46100000>;
			compression = "none";
		};
	};

	configurations {
		default = "config-1";

		config-1 {
			description = "UART BOOTLOADER";
			kernel = "kernel";
			fdt = "fdt";
			loadables = "ramdisk";
		};
	};
};
```

## src/kernel.its
```
/dts-v1/;

/ {
	description = "U-boot FIT Image for VisionFive 2";
	#address-cells = <2>;

	images {
		kernel {
			description = "Kernel Image";
			data = /incbin/("../build/kernel.bin");
			type = "kernel";
			arch = "riscv";
			os = "linux";
			compression = "none";
			load = <0x0 0x40200000>;
			entry = <0x0 0x40200000>;
		};

		fdt {
			description = "Flat Device Tree";
			data = /incbin/("../res/jh7110-starfive-visionfive-2-v1.3b.dtb");
			type = "flat_dt";
			arch = "riscv";
			compression = "none";
			load = <0x0 0x46000000>;
		};

		ramdisk {
			description = "Initial Ramdisk";
			data = /incbin/("../res/initramfs.cpio");
			type = "ramdisk";
			arch = "riscv";
			os = "linux";
			compression = "none";
			load = <0x0 0x46100000>;
		};
	};

	configurations {
		default = "config-1";

		config-1 {
			description = "NYCU OSC RISC-V KERNEL";
			kernel = "kernel";
			fdt = "fdt";
			ramdisk = "ramdisk";
		};
	};
};
```
